/*************************************
 * draws a maze that can be navigated
 * 
 * 
 */
const unsigned char maze1 [] PROGMEM = {
  // 'maze, 200x175px
  0x00, 0x00, 0x00, 0x00, 0x00, 0x00, 0x00, 0x00, 0x00, 0x00, 0x00, 0x00, 0x00, 0x00, 0x00, 0x00, 
  0x00, 0x00, 0x00, 0x00, 0x00, 0x00, 0x00, 0x00, 0x00, 0x00, 0x00, 0x00, 0x00, 0x00, 0x00, 0x00, 
  0x00, 0x00, 0x00, 0x00, 0x00, 0x00, 0x00, 0x00, 0x00, 0x00, 0x00, 0x00, 0x00, 0x00, 0x00, 0x00, 
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  0x00, 0x00, 0x00, 0x00, 0x00, 0x00, 0x00
};


 void maze(){
  if(!mazeLoaded){
    tft.drawBitmap(145, 78, maze1, 200, 175, HX8357_WHITE);
    mazeLoaded = true;
    }
    tft.drawPixel(multX, multY, HX8357_RED);
  digitalRead(encoder1But);
  if(digitalRead(encoder1But) == LOW){
    mode = 1;
  }
//encoder0 = left
  n0 = digitalRead(encoder0PinA);
  if ((encoder0PinALast == LOW) && (n0 == HIGH)) {
    if (digitalRead(encoder0PinB) == LOW) {
      encoder0Pos--;
      multX = multX - 1;
    } else {
      encoder0Pos++;
      multX = multX + 1;
    }
    Serial.print (encoder0Pos);
    Serial.print ("/");
  }
  encoder0PinALast = n0;

  //encoder1 = right
  n1 = digitalRead(encoder1PinA);
  if ((encoder1PinALast == LOW) && (n1 == HIGH)) {
    if (digitalRead(encoder1PinB) == LOW) {
      encoder1Pos--;
      multY = multY + 1;
    } else {
      encoder1Pos++;
      multY = multY - 1;
    }
    Serial.print (encoder1Pos);
    Serial.print ("/");
  }
  encoder1PinALast = n1;
  
   if(( multY == 235) && ( multX == 323)) {
    tft.setTextColor(HX8357_RED);    tft.setTextSize(6);
  tft.setCursor(140, 20);
  tft.println("WINNER");
    
  }
 }

